## arch/loongarch/Kconfig
```kconfig
# SPDX-License-Identifier: Apache-2.0
# Copyright 2024 Loongson Technology Corporation Limited

if ARCH_LOONGARCH

choice
	prompt "LoongArch chip"
	default ARCH_CHIP_LS2K0300

config ARCH_CHIP_LS2K0300
	bool "Loongson LS2K0300"

config ARCH_CHIP_QEMU_LOONGARCH
	bool "QEMU virt (LA64)"
	select ARCH_HAVE_MULTICPU
	select SERIAL_UART_ARCH_MMIO

endchoice

config ARCH_CHIP
	string
	default "ls2k0300" if ARCH_CHIP_LS2K0300
	default "qemu" if ARCH_CHIP_QEMU_LOONGARCH

config ARCH_LOONGARCH64
	bool
	default y
	select ARCH_HAVE_FORK if BUILD_FLAT
	select ARCH_HAVE_STACKCHECK
	select ARCH_HAVE_SETJMP
	select ARCH_SETJMP_H
	select ARCH_HAVE_ADDRENV
	select ARCH_NEED_ADDRENV_MAPPING
	select ARCH_KERNEL_STACK if BUILD_KERNEL
	select LIBC_ARCH_ELF_64BIT if LIBC_ARCH_ELF
	select ARCH_HAVE_MMU
	select ARCH_HAVE_FPU
	select ARCH_HAVE_DPFPU
	select ARCH_HAVE_TESTSET

config ARCH_USE_MMU
	default y
	select MM_PGALLOC

config LOONGARCH_MMU_PTW
	bool "Use hardware page walking when available"
	default y
	depends on ARCH_USE_MMU
	---help---
		Enable PWCH.HPTW only when CPUCFG2 advertises hardware page
		walking. Other CPUs use the software refill handler. Disable
		this option to test software refill on a PTW-capable CPU.

config LOONGARCH_PAGE_POOL_SIZE
	hex "Physical page pool size"
	default 0x200000
	depends on MM_PGALLOC
	---help---
		Reserve this many bytes at the end of RAM for the NuttX page
		allocator. The size must be a multiple of 4096 and must leave
		enough memory for the kernel, idle stacks, and normal heap.

config LOONGARCH_ASID_BITS
	int "Maximum ASID width"
	default 10
	range 2 10
	depends on ARCH_ADDRENV
	---help---
		Limit the number of hardware address-space identifier bits used
		on each CPU. The CPU's ASIDBITS value can reduce this further.
		ASID zero is reserved for the boot mappings. Normally use all ten
		bits; smaller values allow regression tests to force ASID reuse.

config LOONGARCH_USER_ACCESS
	bool "Strict user syscall argument validation"
	default y
	depends on BUILD_KERNEL
	---help---
		Stage supported syscall arguments in kernel-owned buffers. Reject
		interfaces without an argument policy with ENOSYS. Device ioctls,
		asynchronous operations and complex user synchronization objects
		require separate adapters before they can be enabled safely.

config LOONGARCH_USER_COPY_MAX
	int "Maximum staged bytes per user syscall"
	default 65536
	range 4096 1048576
	depends on LOONGARCH_USER_ACCESS

config LOONGARCH_DEMAND_PAGING
	bool "Demand-zero process heaps and copy-on-write pages"
	default y
	depends on BUILD_KERNEL
	---help---
		Reserve process heap pages without allocating physical storage.
		Reads share an immutable zero page; writes allocate private pages.
		Resolve page faults in thread context and synchronize all CPUs
		before releasing replaced backing pages.

config LOONGARCH_VM_TEST
	bool "Test demand-zero pages, COW and checked user copies"
	default y if LOONGARCH_USER_TEST
	depends on LOONGARCH_DEMAND_PAGING
	---help---
		Exercise actual page faults and independent COW roots before user
		startup in the QEMU regression configuration.

config LOONGARCH_INITIAL_HEAP_SIZE
	hex "Initially resident user heap size"
	default 0x10000
	depends on LOONGARCH_DEMAND_PAGING
	---help---
		Keep this page-aligned bootstrap heap resident for the ELF loader,
		which initializes allocator metadata and the initial user stack
		with interrupts masked. Later heap extensions are demand-zero.
		This must accommodate the initial stack and allocator overhead.

config LOONGARCH_ASID_TEST
	bool "Test ASID retention and rollover before user startup"
	depends on LOONGARCH_USER_TEST && LOONGARCH_ASID_BITS <= 3
	depends on DEBUG_ASSERTIONS
	---help---
		Create more address environments than available ASIDs and check
		translations at identical virtual addresses on every CPU. Run
		before any user process starts, while ASID zero is still active.

config LOONGARCH_MMU_TEST
	bool "Build the MMU and SMP bring-up test"
	depends on ARCH_USE_MMU && DEBUG_ASSERTIONS
	---help---
		Provide loongarch_mmutest_main as an optional init entry point.
		Test page mapping, even/odd TLB refill, cross-CPU remapping,
		page-table reclamation and allocation failure rollback.

config LOONGARCH_MMU_TEST_FAULT
	int "Expected page fault after the MMU test (0=none, 1=write, 2=read)"
	default 0
	range 0 2
	depends on LOONGARCH_MMU_TEST
	---help---
		After the normal tests, deliberately write to a read-only page
		or read an unmapped page. These negative tests must terminate
		in the exception handler. Do not enable for normal operation.

config LOONGARCH_USER_TEST
	bool "Run ELF process isolation and syscall tests"
	depends on BUILD_KERNEL && ARCH_CHIP_QEMU_LOONGARCH
	select BOARD_LATE_INITIALIZE
	select FS_TMPFS
	---help---
		Embed a standalone ELF regression program and launch concurrent
		processes through the NuttX loader. Test syscalls, signals, private
		data, and user faults without terminating the kernel.

source "arch/loongarch/src/ls2k0300/Kconfig"

endif # ARCH_LOONGARCH
```

## boards/loongarch/qemu/qemu-loongarch/configs/apps-elf/defconfig
```kconfig
# SPDX-License-Identifier: Apache-2.0
CONFIG_ALLOW_BSD_COMPONENTS=y
CONFIG_ALLOW_MIT_COMPONENTS=y
CONFIG_ALLOW_CUSTOM_PERMISSIVE_COMPONENTS=y
CONFIG_BASE_DEFCONFIG="qemu-loongarch/apps-elf"
CONFIG_DEBUG_FEATURES=y
CONFIG_DEBUG_ASSERTIONS=y
CONFIG_STACK_COLORATION=y
CONFIG_DEBUG_SYMBOLS=y
CONFIG_DEBUG_FULLOPT=y
CONFIG_ARCH_LOONGARCH=y
CONFIG_ARCH_CHIP_QEMU_LOONGARCH=y
CONFIG_LOONGARCH_PAGE_POOL_SIZE=0x1000000
CONFIG_LOONGARCH_STRING_FUNCTION=y
CONFIG_BOARD_LOOPSPERMSEC=10000
CONFIG_ARCH_INTERRUPTSTACK=4096
CONFIG_RAM_START=0x9000000000200000
CONFIG_RAM_SIZE=134217728
CONFIG_ARCH_BOARD_QEMU_LOONGARCH=y
CONFIG_BOARDCTL_ROMDISK=y
CONFIG_SPINLOCK=y
CONFIG_IRQ_WORK_STACKSIZE=2048
CONFIG_INIT_STACKSIZE=8192
CONFIG_INIT_ENTRYPOINT="nsh_main"
CONFIG_RR_INTERVAL=10
CONFIG_SCHED_HAVE_PARENT=y
CONFIG_SCHED_CHILD_STATUS=y
CONFIG_PTHREAD_MUTEX_DEFAULT_PRIO_NONE=y
CONFIG_CANCELLATION_POINTS=y
CONFIG_PRIORITY_INHERITANCE=y
CONFIG_BOARD_INITTHREAD_STACKSIZE=2048
CONFIG_SIG_EVTHREAD=y
CONFIG_SIG_DEFAULT=y
CONFIG_SCHED_HPWORKSTACKSIZE=8192
CONFIG_SCHED_LPWORK=y
CONFIG_SCHED_LPNTHREADS=1
CONFIG_SCHED_LPWORKSTACKSIZE=8192
CONFIG_DEFAULT_TASK_STACKSIZE=16384
CONFIG_IDLETHREAD_STACKSIZE=4096
CONFIG_PTHREAD_STACK_DEFAULT=65536
CONFIG_TIMER=y
CONFIG_MTD=y
CONFIG_MTD_PARTITION=y
CONFIG_MTD_CONFIG=y
CONFIG_RAMMTD=y
CONFIG_16550_UART=y
CONFIG_16550_UART0=y
CONFIG_16550_UART0_BASE=0x800000001fe001e0
CONFIG_16550_UART0_CLOCK=1843200
CONFIG_16550_UART0_IRQ=130
CONFIG_16550_UART0_SERIAL_CONSOLE=y
CONFIG_16550_ADDRWIDTH=0
CONFIG_SERIAL_TERMIOS=y
CONFIG_NETDEV_IFINDEX=y
CONFIG_NET_IPv6=y
CONFIG_NET_LOCAL=y
CONFIG_NET_LOCAL_SCM=y
CONFIG_NET_NETLINK=y
CONFIG_NETLINK_ROUTE=y
# CONFIG_NET_TCP_NO_STACK is not set
CONFIG_NET_TCP_WRITE_BUFFERS=y
CONFIG_NET_UDP=y
# CONFIG_NET_UDP_NO_STACK is not set
# CONFIG_NET_UDP_CHECKSUMS is not set
CONFIG_NET_ICMP_SOCKET=y
CONFIG_NET_ICMPv6=y
CONFIG_NET_ICMPv6_SOCKET=y
CONFIG_NET_USRSOCK=y
CONFIG_FS_LOCK_BUCKET_SIZE=32
CONFIG_FS_LINKS=y
CONFIG_TIMER_FD=y
CONFIG_FS_AIO=y
CONFIG_FS_SHMFS=y
CONFIG_FS_RAMMAP=y
CONFIG_FS_FAT=y
CONFIG_FAT_LFN=y
CONFIG_FAT_MAXFNAME=64
CONFIG_FAT_LFN_UTF8=y
CONFIG_FS_NXFFS=y
CONFIG_FS_ROMFS=y
CONFIG_FS_BINFS=y
CONFIG_FS_PROCFS=y
CONFIG_FS_UNIONFS=y
CONFIG_FS_USERFS=y
CONFIG_IOB_NBUFFERS=128
CONFIG_IOB_NCHAINS=16
CONFIG_IOB_THROTTLE=0
CONFIG_ELF=y
CONFIG_ELF_STACKSIZE=65536
CONFIG_BINFMT_CONSTRUCTORS=y
CONFIG_LIBC_SCANSET=y
CONFIG_POSIX_SPAWN_DEFAULT_STACKSIZE=2048
CONFIG_NAME_MAX=255
CONFIG_PATH_MAX=512
CONFIG_LINE_MAX=256
CONFIG_LIBC_STRERROR=y
CONFIG_LIBC_DLFCN=y
CONFIG_LIBC_LZF=y
CONFIG_TLS_NELEM=8
CONFIG_TLS_TASK_NELEM=8
CONFIG_TLS_NCLEANUP=4
CONFIG_LIBC_NETDB=y
CONFIG_LIBC_MEMFD_ERROR=y
CONFIG_BUILTIN=y
CONFIG_LIBC_FDT=y
CONFIG_LIBM=y
CONFIG_HAVE_CXX=y
CONFIG_LIBCXX=y
CONFIG_LIBCXXABI=y
CONFIG_CXX_RTTI=y
CONFIG_CXX_LOCALIZATION=y
CONFIG_AUDIOUTILS_MMLPARSER_LIB=y
CONFIG_BENCHMARK_CYCLICTEST=y
CONFIG_BENCHMARK_DHRYSTONE=y
CONFIG_BENCHMARK_OSPERF=y
CONFIG_BENCHMARK_OSPERF_STACKSIZE=8192
CONFIG_BENCHMARK_RAMSPEED=y
CONFIG_BENCHMARK_RAMSPEED_STACKSIZE=8192
CONFIG_BENCHMARK_SPINLOCK=y
CONFIG_BENCHMARK_TACLEBENCH=y
CONFIG_BENCHMARK_TACLEBENCH_STACKSIZE=65536
CONFIG_BENCHMARK_TINY_MEMBENCH=y
CONFIG_BENCHMARK_TINY_MEMBENCH_STACKSIZE=8192
CONFIG_BENCHMARK_WHETSTONE=y
CONFIG_BENCHMARK_WHETSTONE_STACKSIZE=8192
CONFIG_CRYPTO_MBEDTLS=y
CONFIG_MBEDTLS_SELF_TEST=y
CONFIG_MBEDTLS_APPS=y
CONFIG_MBEDTLS_APP_BENCHMARK=y
CONFIG_MBEDTLS_APP_BENCHMARK_STACKSIZE=65536
CONFIG_MBEDTLS_APP_SELFTEST=y
CONFIG_MBEDTLS_APP_SELFTEST_STACKSIZE=65536
CONFIG_EXAMPLES_BASTEST=y
CONFIG_EXAMPLES_CALIB_UDELAY=y
CONFIG_EXAMPLES_CCTYPE=y
CONFIG_EXAMPLES_CONFIGDATA=y
CONFIG_EXAMPLES_CONFIGDATA_NLOOPS=10
CONFIG_EXAMPLES_ELF=y
CONFIG_EXAMPLES_HELLO=y
CONFIG_EXAMPLES_HELLO_STACKSIZE=2048
CONFIG_EXAMPLES_HELLOXX=y
CONFIG_EXAMPLES_INI_DUMPER=y
CONFIG_EXAMPLES_INI_DUMPER_STACKSIZE=8192
CONFIG_EXAMPLES_IPCFG=y
CONFIG_EXAMPLES_IPCFG_STACKSIZE=8192
CONFIG_EXAMPLES_JSON=y
CONFIG_EXAMPLES_LIBTEST=y
CONFIG_EXAMPLES_LIBTEST_CMDTOOL=y
CONFIG_EXAMPLES_LIBTEST_STACKSIZE=8192
CONFIG_EXAMPLES_MMLPARSER=y
CONFIG_EXAMPLES_MODULE=y
CONFIG_EXAMPLES_MTDPART=y
CONFIG_EXAMPLES_NETLINK_ROUTE=y
CONFIG_EXAMPLES_NETLINK_ROUTE_STACKSIZE=8192
CONFIG_EXAMPLES_NETLOOP=y
CONFIG_EXAMPLES_NETLOOP_STACKSIZE=8192
CONFIG_EXAMPLES_NETTEST=y
CONFIG_EXAMPLES_NETTEST_STACKSIZE1=8192
CONFIG_EXAMPLES_NETTEST_LOOPBACK=y
CONFIG_EXAMPLES_NETTEST_DAEMON_STACKSIZE=8192
CONFIG_EXAMPLES_NNG_TEST=y
CONFIG_EXAMPLES_NNG_TEST_STACKSIZE=8192
CONFIG_EXAMPLES_NULL=y
CONFIG_EXAMPLES_PIPE=y
CONFIG_EXAMPLES_PIPE_STACKSIZE=2048
CONFIG_EXAMPLES_POLL=y
CONFIG_EXAMPLES_POPEN=y
CONFIG_EXAMPLES_POPEN_STACKSIZE=8192
CONFIG_EXAMPLES_POSIX_STDIO=y
CONFIG_EXAMPLES_POSIX_STDIO_STACKSIZE=8192
CONFIG_EXAMPLES_ROMFS=y
CONFIG_EXAMPLES_SETTINGS=y
CONFIG_EXAMPLES_SHM=y
CONFIG_EXAMPLES_SHM_STACKSIZE=8192
CONFIG_EXAMPLES_SMF=y
CONFIG_EXAMPLES_SOTEST=y
CONFIG_EXAMPLES_STAT=y
CONFIG_EXAMPLES_STAT_STACKSIZE=8192
CONFIG_EXAMPLES_SYSTEM=y
CONFIG_EXAMPLES_SYSTEM_STACKSIZE=8192
CONFIG_EXAMPLES_TCP_IPC_CLIENT=y
CONFIG_EXAMPLES_TIFF=y
CONFIG_EXAMPLES_UDGRAM=y
CONFIG_EXAMPLES_UDGRAM_SERVER_PROGNAME="udgram_server"
CONFIG_EXAMPLES_UDGRAM_CLIENT_PROGNAME="udgram_client"
CONFIG_EXAMPLES_UDP=y
CONFIG_EXAMPLES_UDP_STACKSIZE1=8192
CONFIG_EXAMPLES_UDP_TARGET2=y
CONFIG_EXAMPLES_UDP_STACKSIZE2=8192
CONFIG_EXAMPLES_UDP_SERVERIP=0x7f000001
CONFIG_EXAMPLES_UID=y
CONFIG_EXAMPLES_UID_STACKSIZE=8192
CONFIG_EXAMPLES_UNIONFS=y
CONFIG_EXAMPLES_USERFS=y
CONFIG_EXAMPLES_USERFS_STACKSIZE=8192
CONFIG_EXAMPLES_USRSOCKTEST=y
CONFIG_EXAMPLES_USTREAM=y
CONFIG_FSUTILS_INIH=y
CONFIG_FSUTILS_IPCFG=y
CONFIG_FSUTILS_MKGPT=y
CONFIG_FSUTILS_MKMBR=y
CONFIG_TIFF=y
CONFIG_INTERPRETERS_BAS=y
CONFIG_INTERPRETERS_BERRY=y
CONFIG_INTERPRETERS_DUKTAPE=y
CONFIG_INTERPRETERS_DUKTAPE_STACKSIZE=65536
CONFIG_INTERPRETERS_LUA=y
CONFIG_INTERPRETERS_MINIBASIC=y
CONFIG_INTERPRETERS_MINIBASIC_TESTSCRIPT=y
CONFIG_INTERPRETERS_MQJS=y
CONFIG_INTERPRETERS_TOYWASM=y
CONFIG_INTERPRETERS_TOYWASM_STACKSIZE=8192
CONFIG_INTERPRETERS_WASM3=y
CONFIG_INTERPRETERS_WASM3_STACKSIZE=8192
CONFIG_LOGGING_EMBEDLOG=y
CONFIG_EMBEDLOG_ENABLE_OUT_FILE=y
CONFIG_EMBEDLOG_ENABLE_BINARY_LOGS=y
CONFIG_EMBEDLOG_ENABLE_OUT_CUSTOM=y
CONFIG_EMBEDLOG_ENABLE_PREFIX=y
CONFIG_EMBEDLOG_ENABLE_COLORS=y
CONFIG_EMBEDLOG_DEMO_PROGRAMS=y
CONFIG_EMBEDLOG_DEMO_PROGRAMS_STACKSIZE=8192
CONFIG_MATH_LIBTOMMATH=y
CONFIG_LIBTOMMATH_DEMOS=y
CONFIG_NETUTILS_CJSON=y
CONFIG_NETUTILS_CODECS=y
CONFIG_NETUTILS_IPERF=y
CONFIG_NETUTILS_IPERF_STACKSIZE=8192
CONFIG_NETUTILS_IPERFTEST_DEVNAME="lo"
CONFIG_NETUTILS_NANOPB=y
CONFIG_NETUTILS_NANOPB_EXAMPLE=y
CONFIG_NETUTILS_NANOPB_EXAMPLE_STACKSIZE=8192
CONFIG_NETUTILS_NETCAT=y
CONFIG_NETUTILS_NETCAT_STACKSIZE=8192
CONFIG_NETUTILS_NNG=y
CONFIG_NSH_PROMPT_MAX=32
CONFIG_NSH_READLINE=y
CONFIG_NSH_BUILTIN_APPS=y
CONFIG_NSH_FILE_APPS=y
CONFIG_SYSTEM_ARGTABLE3_TEST=y
CONFIG_SYSTEM_ARGTABLE3_TEST_STACKSIZE=65536
CONFIG_SYSTEM_CPULOAD=y
CONFIG_SYSTEM_DD_STACKSIZE=2048
CONFIG_SYSTEM_FDTDUMP=y
CONFIG_SYSTEM_FDTGET=y
CONFIG_SYSTEM_FDTPUT=y
CONFIG_SYSTEM_FDTOVERLAY=y
CONFIG_SYSTEM_HEX2BIN=y
CONFIG_SYSTEM_HEX2BIN_BUILTIN=y
CONFIG_SYSTEM_HEXED=y
CONFIG_SYSTEM_HEXED_STACKSIZE=8192
CONFIG_SYSTEM_HOSTNAME=y
CONFIG_SYSTEM_LZF=y
CONFIG_SYSTEM_LZF_STACKSIZE=8192
CONFIG_SYSTEM_NETDB=y
CONFIG_SYSTEM_NETDB_STACKSIZE=8192
CONFIG_SYSTEM_NSH=y
CONFIG_SYSTEM_NSH_STACKSIZE=2048
CONFIG_SYSTEM_PING=y
CONFIG_SYSTEM_PING_STACKSIZE=8192
CONFIG_SYSTEM_PING6=y
CONFIG_SYSTEM_PING6_STACKSIZE=8192
CONFIG_SYSTEM_POPEN=y
CONFIG_SYSTEM_POPEN_STACKSIZE=8192
CONFIG_SYSTEM_RESMONITOR=y
CONFIG_SYSTEM_SETLOGMASK=y
CONFIG_SYSTEM_SETLOGMASK_STACKSIZE=8192
CONFIG_SYSTEM_SETTINGS=y
CONFIG_SYSTEM_SMF=y
CONFIG_SYSTEM_SMF_ANCESTOR_SUPPORT=y
CONFIG_SYSTEM_SMF_INITIAL_TRANSITION=y
CONFIG_SYSTEM_STACKMONITOR=y
CONFIG_SYSTEM_STACKMONITOR_STACKSIZE=8192
CONFIG_SYSTEM_STTY=y
CONFIG_SYSTEM_STTY_STACKSIZE=8192
CONFIG_SYSTEM_SYSTEM_STACKSIZE=8192
CONFIG_SYSTEM_TEE=y
CONFIG_SYSTEM_VI=y
CONFIG_SYSTEM_VI_STACKSIZE=8192
CONFIG_LIB_ZLIB=y
CONFIG_LIB_ZLIB_TEST=y
CONFIG_LIB_ZLIB_TEST_STACKSIZE=8192
CONFIG_UTILS_GZIP=y
CONFIG_UTILS_ZIP=y
CONFIG_UTILS_ZIP_STACKSIZE=131072
CONFIG_UTILS_UNZIP=y
CONFIG_TESTING_CMOCKA=y
CONFIG_TESTING_CMOCKA_PROG=y
CONFIG_TESTING_CMOCKA_STACKSIZE=8192
CONFIG_TESTING_CXXSIZE=y
CONFIG_TESTING_CXXTEST=y
CONFIG_TESTING_EPOLL=y
CONFIG_TESTING_EPOLL_STACKSIZE=8192
CONFIG_TESTING_FATUTF8=y
CONFIG_TESTING_FSTEST=y
CONFIG_TESTING_FSTEST_STACKSIZE=8192
CONFIG_TESTING_FSTEST_MAXOPEN=32
CONFIG_TESTING_FSTEST_MOUNTPT="/data"
CONFIG_TESTING_FSTEST_NLOOPS=3
CONFIG_TESTING_NXFFS=y
CONFIG_TESTING_NXFFS_NLOOPS=3
CONFIG_TESTING_ARCH_LIBC=y
CONFIG_TESTING_ARCH_LIBC_STACKSIZE=8192
CONFIG_TESTING_ATOMIC=y
CONFIG_TESTING_ATOMIC_STACKSIZE=2048
CONFIG_TESTING_CRC_TEST=y
CONFIG_TESTING_CRC_TEST_STACKSIZE=8192
CONFIG_TESTING_FMEMOPEN_TEST=y
CONFIG_TESTING_FOPENCOOKIE_TEST=y
CONFIG_TESTING_OPEN_MEMSTREAM=y
CONFIG_TESTING_POPEN=y
CONFIG_TESTING_SCANFTEST=y
CONFIG_TESTING_SCANFTEST_STACKSIZE=8192
CONFIG_TESTING_SCANFTEST_FNAME="/data/scanf.txt"
CONFIG_TESTING_STDBIT_TEST=y
CONFIG_TESTING_WCSTOMBS=y
CONFIG_TESTING_WCSTOMBS_STACKSIZE=8192
CONFIG_TESTING_HEAP=y
CONFIG_TESTING_HEAP_STACKSIZE=2048
CONFIG_TESTING_IOB=y
CONFIG_TESTING_IOB_STACKSIZE=8192
CONFIG_TESTING_MEMORY_STRESS=y
CONFIG_TESTING_MEMORY_STRESS_STACKSIZE=8192
CONFIG_TESTING_RAMTEST=y
CONFIG_TESTING_RAMTEST_STACKSIZE=8192
CONFIG_TESTING_NET_TEST=y
CONFIG_TESTING_NET_TEST_STACKSIZE=8192
# CONFIG_TESTING_NET_OTHERS is not set
CONFIG_TESTING_NUTS=y
CONFIG_TESTING_NUTS_STACKSIZE=8192
CONFIG_TESTING_NUTS_DSTRUCTS=y
CONFIG_TESTING_NUTS_DEVICES=y
CONFIG_TESTING_OSTEST=y
CONFIG_TESTING_OSTEST_AIO=y
CONFIG_TESTING_OSTEST_AIOPATH="/data"
CONFIG_TESTING_OSTEST_FPUSTACKSIZE=2048
CONFIG_TESTING_GETPRIME=y
CONFIG_TESTING_GETPRIME_STACKSIZE=8192
CONFIG_TESTING_PTHREAD_MUTEX_PERF=y
CONFIG_TESTING_PTHREAD_MUTEX_PERF_STACKSIZE=8192
CONFIG_TESTING_TIMERJITTER=y
CONFIG_TESTING_TIMERJITTER_STACKSIZE=8192
CONFIG_TESTS_TESTSUITES=y
CONFIG_CM_FS_TEST=y
CONFIG_CM_SCHED_TEST=y
CONFIG_CM_MM_TEST=y
CONFIG_CM_TIME_TEST=y
CONFIG_CM_PTHREAD_TEST=y
CONFIG_CM_MUTEX_TEST=y
CONFIG_ARCH="loongarch"
CONFIG_ARCH_CHIP="qemu"
CONFIG_ARCH_BOARD="qemu-loongarch"
```
